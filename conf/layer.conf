## conf/layer.conf
```bitbake
# We have a conf and classes directory, add to BBPATH
BBPATH .= ":${LAYERDIR}"

# We have a packages directory, add to BBFILES
BBFILES += "${LAYERDIR}/recipes-*/*/*.bb \
            ${LAYERDIR}/recipes-*/*/*.bbappend"

BBFILE_PRIORITY_iei-imx-bsp = "10"

BBFILE_COLLECTIONS += "iei-imx-bsp"
BBFILE_PATTERN_iei-imx-bsp := "^${LAYERDIR}"

LAYERSERIES_COMPAT_iei-imx-bsp = "kirkstone"
```

## conf/machine/iaso-imx8mm.conf
```bitbake
#@TYPE: Machine
#@NAME: IASO-IMX8MM
#@SOC: i.MX8MM
#@DESCRIPTION: Machine configuration for IEI World IASO-IMX8MM
#@MAINTAINER: CM Wang <cmwang@ieiworld.com>

require conf/machine/include/imx8mm-evk.inc

OVERRIDES:append = "${@bb.utils.contains_any('DISTRO', 'imx-desktop-xwayland imx-desktop-x11', ':ubuntu', '', d)}"

# rootfs
IMAGE_INSTALL:append = " cloud-utils-growpart tn-growpart-helper tn-ubuntu-custom packagegroup-iei-network packagegroup-iei-dqv brcm-patchram-plus zram iei-log"

IMAGE_INSTALL:remove:ubuntu = " packagegroup-iei-network"

# kernel
IMX_KERNEL_CONFIG_AARCH64:iaso-imx8mm = "iei_imx8_defconfig"

# The device tree name is implicit for LPDDR4, so can't use MACHINE here
KERNEL_DEVICETREE_BASENAME = "imx8mm-b664-ppc"
KERNEL_DEVICETREE = " \
	freescale/${KERNEL_DEVICETREE_BASENAME}.dtb \
"
KERNEL_DEVICETREE:remove = " \
	freescale/${KERNEL_DEVICETREE_BASENAME}-pcie-ep.dtb \
	freescale/${KERNEL_DEVICETREE_BASENAME}-rm67191.dtb \
"

# u-boot
UBOOT_CONFIG_BASENAME = "imx8mm_b664_ppc"
UBOOT_CONFIG[mfgtool] = "${UBOOT_CONFIG_BASENAME}_defconfig"
UBOOT_CONFIG[emmc] = "${UBOOT_CONFIG_BASENAME}_defconfig"
UBOOT_DTB_NAME = "imx8mm-b664-ppc.dtb"

# Set DDR FIRMWARE
LPDDR_FIRMWARE_VERSION = "_202006"
DDR_FIRMWARE_NAME = " \
        lpddr4_pmu_train_1d_imem${LPDDR_FIRMWARE_VERSION}.bin \
        lpddr4_pmu_train_1d_dmem${LPDDR_FIRMWARE_VERSION}.bin \
        lpddr4_pmu_train_2d_imem${LPDDR_FIRMWARE_VERSION}.bin \
        lpddr4_pmu_train_2d_dmem${LPDDR_FIRMWARE_VERSION}.bin \
"

# Set imx-mkimage boot target
IMXBOOT_TARGETS_BASENAME = "flash_evk_no_hdmi"

# Set Serial console
SERIAL_CONSOLES = "115200;ttymxc1"
```

## conf/machine/wafer-imx8mp.conf
```bitbake
#@TYPE: Machine
#@NAME: WAFER-IMX8MP
#@SOC: i.MX8MP
#@DESCRIPTION: Machine configuration for IEI World WAFER-IMX8MP
#@MAINTAINER: Wig Cheng <wigcheng@ieiworld.com>

require conf/machine/include/imx8mp-evk.inc

OVERRIDES:append = "${@bb.utils.contains_any('DISTRO', 'imx-desktop-xwayland imx-desktop-x11', ':ubuntu', '', d)}"

# rootfs
IMAGE_INSTALL:append = " cloud-utils-growpart tn-growpart-helper tn-ubuntu-custom packagegroup-iei-network packagegroup-iei-dqv"

IMAGE_INSTALL:remove:ubuntu = " packagegroup-iei-network"

# kernel
IMX_KERNEL_CONFIG_AARCH64_wafer-imx8mp = "iei_imx8_defconfig"

# The device tree name is implicit for LPDDR4, so can't use MACHINE here
KERNEL_DEVICETREE_BASENAME = "imx8mp-b643-ppc"
KERNEL_DEVICETREE = " \
	freescale/${KERNEL_DEVICETREE_BASENAME}-mipi-dsi-tq101aj02.dtb \
	freescale/${KERNEL_DEVICETREE_BASENAME}-sound-max98090.dtb \
	freescale/${KERNEL_DEVICETREE_BASENAME}-uart-rs422.dtb \
	freescale/${KERNEL_DEVICETREE_BASENAME}-uart-rs485.dtb \
	freescale/${KERNEL_DEVICETREE_BASENAME}.dtb \
"

# u-boot
UBOOT_CONFIG_BASENAME = "imx8mp_b643_ppc"
UBOOT_CONFIG[fspi] = "${UBOOT_CONFIG_BASENAME}_defconfig"
UBOOT_DTB_NAME = "imx8mp-b643-ppc.dtb"

# Set DDR FIRMWARE
DDR_FIRMWARE_VERSION = "_202006"
DDR_FIRMWARE_NAME = " \
        lpddr4_pmu_train_1d_imem${DDR_FIRMWARE_VERSION}.bin \
        lpddr4_pmu_train_1d_dmem${DDR_FIRMWARE_VERSION}.bin \
        lpddr4_pmu_train_2d_imem${DDR_FIRMWARE_VERSION}.bin \
        lpddr4_pmu_train_2d_dmem${DDR_FIRMWARE_VERSION}.bin \
"

# Set imx-mkimage boot target
IMXBOOT_TARGETS_BASENAME = "flash_evk"

# Set Serial console
SERIAL_CONSOLES = "115200;ttymxc1"
```
